## drivers/soc/oppo/oppo_mdmrst/Kconfig
```kconfig
# ifdef CONFIG_MACH_REALME_TRINKET
# yixue.ge add for config oppo software common soft
config RECORD_MDMRST
bool "config record mdmrst"
help
    define this config to count the modem restart times.
#endif /* CONFIG_MACH_REALME_TRINKET */
```
